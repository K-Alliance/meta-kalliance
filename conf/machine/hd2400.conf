## conf/machine/hd2400.conf
```bitbake
#@TYPE: Machine
#@NAME: hd2400
#@DESCRIPTION: Machine configuration for the hd2400

MKUBIFS_ARGS = "-m 2048 -e 126976 -c 8192"
UBINIZE_ARGS = "-m 2048 -p 128KiB"

MACHINE_FEATURES += "dvb-c transcoding"

CHIPSET = "bcm7425"
RCTYPE = "19"

require conf/machine/include/k-alliance.inc
```

## conf/machine/triplex.conf
```bitbake
#@TYPE: Machine
#@NAME: AX triplex
#@DESCRIPTION: Machine configuration for the triplex

MKUBIFS_ARGS = "-m 2048 -e 126976 -c 8192"
UBINIZE_ARGS = "-m 2048 -p 128KiB"

MACHINE_FEATURES += "textlcd dvb-c"

CHIPSET = "bcm7356"
RCTYPE = "UNKNOWN"

require conf/machine/include/k-alliance.inc
```

## conf/machine/xp1000.conf
```bitbake
#@TYPE: Machine
#@NAME: xp1000
#@DESCRIPTION: Machine configuration for the xp1000

MKUBIFS_ARGS = "-m 2048 -e 126976 -c 4096"
UBINIZE_ARGS = "-m 2048 -p 128KiB"

DEFAULTTUNE = "mips32el-nf"

CHIPSET = "bcm7358"
RCTYPE = "16"

require conf/machine/include/k-alliance.inc
```
